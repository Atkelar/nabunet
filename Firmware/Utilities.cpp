

#include "Utilities.h"
#include "Definitions.h"
#include "Diag.h"
#include "Arduino.h"
#include "ModemHandler.h"
#include <ESP8266WiFi.h>
#include "BlinkyStat.h"


unsigned char shared_buffer[BUFFER_SIZE];

// Table mimics the computation in the Nabu computer: CCITT CRC 16 in "buggy" mode...
const unsigned char CRC_Table[] = {
            0x00, 0x00, 0x21, 0x10, 0x42, 0x20, 0x63, 0x30, 0x84, 0x40, 0xA5, 0x50, 0xC6, 0x60, 0xE7, 0x70,
            0x08, 0x81, 0x29, 0x91, 0x4A, 0xA1, 0x6B, 0xB1, 0x8C, 0xC1, 0xAD, 0xD1, 0xCE, 0xE1, 0xEF, 0xF1,
            0x31, 0x12, 0x10, 0x02, 0x73, 0x32, 0x52, 0x22, 0xB5, 0x52, 0x94, 0x42, 0xF7, 0x72, 0xD6, 0x62,
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            0x17, 0x6E, 0x36, 0x7E, 0x55, 0x4E, 0x74, 0x5E, 0x93, 0x2E, 0xB2, 0x3E, 0xD1, 0x0E, 0xF0, 0x1E
        };

// compute (bad) CRC16 CCITT to match Nabu version. This is also used to sum up the boot images!
int compute_crc16(unsigned char* target, int len)
{
  // this code is a 1:1 reproduction of the assembler version to speed up
  // the development process. It might be beneficial to optimize this...
  int running = 0xffff;
  int index, now;
  for (int i = 0; i < len; i++)
  {
    now = target[i];
    now ^= ((running >> 8) & 0xFF);
    index = now * 2;
  
    running = (running << 8) & 0xff00;
    now = CRC_Table[index];
    running |= now;
    now = CRC_Table[index + 1];
    now ^= (running >> 8);
    running = (now << 8) | (running & 0xff);
  }
  return running;
}

// appends the computed CRC value to the last two bytes in the buffer, so the validate call can check for "==0" later.
void append_crc16(unsigned char* target, int len)
{
  int sum = compute_crc16(target, len - 2);

  sum = (0xFFFF - sum) & 0xFFFF;    // store the "negative" sum for validaton later.

  target[len-2] = (sum >> 8) & 0xFF;
  target[len-1] = (sum & 0xFF);
}

// true if the checksum (at the end of the block) is valid against the expected value.
bool validate_crc16(unsigned char* target, int len)
{
  int sum = compute_crc16(target, len);
  diag("CHKSUM IN: ");
  diaghex(highByte(sum));
  diaghex(lowByte(sum));
 
  return sum == 0x1d0f; // broken CRC implementation. This **should** be zero to the best of my knowlege, but this is how the Nabu does it...
}


// sets the global state machine into error mode and uses the provided blink code.
void modem_panic(int code)
{
  Modem.panic_now(code);
}

// will blink the requested LED for "number" times; Can be used as a status indicator.
void blink_status_confirmed(int ledPin, int number)
{
  Blinky.Signal(ledPin, number);
}


unsigned char translate_wifi_status(int status)
{
  switch(status)
  {
    case WL_IDLE_STATUS:
    case WL_NO_SSID_AVAIL:
    case WL_DISCONNECTED:
      return 0;
    case WL_CONNECTED:
      return 1;
    case WL_CONNECT_FAILED:
      return 2;
    case WL_WRONG_PASSWORD:
      return 3;
  }
  return 0xFF;
}

unsigned char translate_wifi_encryption(unsigned char type)
{
  switch (type)
  {
    case ENC_TYPE_NONE:
      return 0;
    case ENC_TYPE_WEP:
    case ENC_TYPE_TKIP:
    case ENC_TYPE_CCMP:
    case ENC_TYPE_AUTO:
      return 1;
  }
  return 2;
}

unsigned char translate_wifi_signal_strength(int dbm)
{
  if (dbm <= -100)
    return 0;
  if (dbm >= -50)
    return 100;
  return 2 * (dbm + 100); // 0..100
}
